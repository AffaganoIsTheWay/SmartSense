## build/Kconfig/Kconfig.shield
```kconfig
osource "/home/giovanni/Documenti/GitHub/SmartSense/boards/shields/*/Kconfig.shield"
osource "/home/giovanni/ncs/v2.7.0/nrf/boards/shields/*/Kconfig.shield"
```

## build/Kconfig/Kconfig.shield.defconfig
```kconfig
osource "/home/giovanni/Documenti/GitHub/SmartSense/boards/shields/*/Kconfig.defconfig"
osource "/home/giovanni/ncs/v2.7.0/nrf/boards/shields/*/Kconfig.defconfig"
```

## build/SmartSense/Kconfig/Kconfig.shield
```kconfig
osource "C:/Users/Utente/Documents/GitHub/SmartSense/boards/shields/*/Kconfig.shield"
osource "C:/ncs/v2.9.0/nrf/boards/shields/*/Kconfig.shield"
```

## build/SmartSense/Kconfig/Kconfig.shield.defconfig
```kconfig
osource "C:/Users/Utente/Documents/GitHub/SmartSense/boards/shields/*/Kconfig.defconfig"
osource "C:/ncs/v2.9.0/nrf/boards/shields/*/Kconfig.defconfig"
```
